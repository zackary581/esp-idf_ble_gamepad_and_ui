## main/Kconfig.projbuild
```kconfig
menu "Example Configuration"

    config ESP_WIFI_SSID
        string "WiFi SSID"
        default "ESP32 FFBSim AP"
        help
            SSID (network name) for the example to connect to.

    config ESP_WIFI_PASSWORD
        string "WiFi Password"
        default "password1"
        help
            WiFi password (WPA or WPA2) for the example to use.
    config ESP_WIFI_CHANNEL
        int "WiFi Channel"
        range 1 13
        default 1
        help
            WiFi channel (network channel) for the example to use.

    config ESP_MAX_STA_CONN
        int "Maximal STA connections"
        default 4
        help
            Max number of the STA connects to AP.
    config MDNS_HOSTNAME
        string "mDNS Hostname"
        default "esp32-server"
        help
            The mDNS host name used by the ESP32.
    
    config STATIC_IP
        bool "Enable Static IP Address"
        default false
        help
            Enable Static IP Address.
    
    config STATIC_IP_ADDRESS
        depends on STATIC_IP
        string "Static IP Address"
        default "192.168.10.100"
        help
                    Static IP Address for Station.
    
    config STATIC_GW_ADDRESS
        depends on STATIC_IP
        string "Static GW Address"
        default "192.168.10.1"
        help
                    Static GW Address for Station.
    
    config STATIC_NM_ADDRESS
        depends on STATIC_IP
        string "Static Netmask"
        default "255.255.255.0"
        help
            Static Netmask for Station.
    
endmenu
    
menu "HTTP Server Setting"
    
    config WEB_PORT
        int "HTTP Server Port"
        default 8000
        help
            HTTP server port to use.
    
endmenu
```
